## conf/layer.conf
```bitbake
# We have a conf and classes directory, add to BBPATH
BBPATH .= ":${LAYERDIR}"

# We have recipes-* directories, add to BBFILES
BBFILES += "${LAYERDIR}/recipes-*/*/*.bb \
            ${LAYERDIR}/recipes-*/*/*.bbappend"

BBFILE_COLLECTIONS += "meta-rzfive"
BBFILE_PATTERN_meta-rzfive = "^${LAYERDIR}/"
BBFILE_PRIORITY_meta-rzfive = "6"

LAYERDEPENDS_meta-rzfive = "core"
LAYERSERIES_COMPAT_meta-rzfive = "honister dunfell"
```

## conf/machine/hihope-rzg2h.conf
```bitbake
#@TYPE: Machine
#@NAME: hihope-rzg2h machine
#@DESCRIPTION: Hoperun Technology HiHope RZ/G2H platform (hihope-rzg2h)

SOC_FAMILY = "r8a774e1"

DEFAULTTUNE ?= "cortexa57-cortexa53"
TUNE_CONF ?= "conf/machine/include/tune-cortexa57-cortexa53.inc"
require conf/machine/include/${SOC_FAMILY}.inc
require ${TUNE_CONF}

# 32BIT package install (default is disable)
# This variables can be used only in multilib.
USE_32BIT_PKGS ?= "0"
USE_32BIT_WAYLAND ?= "0"
USE_32BIT_MMP ?= "0"

MACHINE_FEATURES = ""

KERNEL_IMAGETYPE = "Image"
IMAGE_FSTYPES_append = " tar.bz2 ext4"

SERIAL_CONSOLE = "115200 ttySC0"

# Configuration for kernel
PREFERRED_PROVIDER_virtual/kernel = "linux-renesas"
# Device tree for RZG2H
KERNEL_DEVICETREE = " \
    renesas/r8a774e1-hihope-rzg2h.dtb \
    renesas/r8a774e1-hihope-rzg2h-ex.dtb \
"

# Configuration for ARM Trusted Firmware
#EXTRA_IMAGEDEPENDS += " arm-trusted-firmware optee-os"

# u-boot
#PREFERRED_VERSION_u-boot = "v2018.09%"
#EXTRA_IMAGEDEPENDS += " u-boot"
# G2H u-boot configure
#UBOOT_CONFIG ??= "hihope-rzg2h"
#UBOOT_CONFIG[hihope-rzg2h] = "r8a774e1_hihope-rzg2h_defconfig"

# flash writer
EXTRA_IMAGEDEPENDS += " flash-writer"

# libdrm
PREFERRED_VERSION_libdrm = "2.4.85"

# Add variable to Build Configuration in build log
BUILDCFG_VARS_append = " SOC_FAMILY"

# Command using to build kernel-module-gles
HOSTTOOLS += "sync"
```

## conf/machine/hihope-rzg2m.conf
```bitbake
#@TYPE: Machine
#@NAME: hihope-rzg2m machine
#@DESCRIPTION: Hoperun Technology HiHope RZ/G2M platform (hihope-rzg2m)

SOC_FAMILY = "r8a774a1"

DEFAULTTUNE ?= "cortexa57-cortexa53"
TUNE_CONF ?= "conf/machine/include/tune-cortexa57-cortexa53.inc"
require conf/machine/include/${SOC_FAMILY}.inc
require ${TUNE_CONF}
require include/ecc-control.inc

# 32BIT package install (default is disable)
# This variables can be used only in multilib.
USE_32BIT_PKGS ?= "0"
USE_32BIT_WAYLAND ?= "0"
USE_32BIT_MMP ?= "0"

MACHINE_FEATURES = ""

KERNEL_IMAGETYPE = "Image"
IMAGE_FSTYPES_append = " tar.bz2 ext4"

SERIAL_CONSOLE = "115200 ttySC0"

# Configuration for kernel
PREFERRED_PROVIDER_virtual/kernel = "linux-renesas"
# Device tree for RZG2M
KERNEL_DEVICETREE = " \
    ${@base_ifelse("${ECC_FULL}" == "2"," "," \
    renesas/r8a774a1-hihope-rzg2m.dtb \
    renesas/r8a774a1-hihope-rzg2m-ex.dtb \
    renesas/r8a774a1-hihope-rzg2m-ex-idk-1110wr.dtb \
    renesas/r8a774a1-hihope-rzg2m-ex-mipi-2.1.dtb \
    renesas/r8a774a1-hihope-rzg2m-rev2.dtb \
    renesas/r8a774a1-hihope-rzg2m-ex-rev2.dtb \
    renesas/r8a774a1-hihope-rzg2m-ex-rev2-idk-1110wr.dtb \
    renesas/r8a774a1-hihope-rzg2m-ex-rev2-mipi-2.1.dtb \
    ")} \
    renesas/r8a774a3-hihope-rzg2m.dtb \
    renesas/r8a774a3-hihope-rzg2m-ex.dtb \
    renesas/r8a774a3-hihope-rzg2m-ex-idk-1110wr.dtb \
    renesas/r8a774a3-hihope-rzg2m-ex-mipi-2.1.dtb \
"

# Configuration for ARM Trusted Firmware
EXTRA_IMAGEDEPENDS += " arm-trusted-firmware optee-os"

# u-boot
PREFERRED_VERSION_u-boot = "v2018.09%"
EXTRA_IMAGEDEPENDS += " u-boot"
# G2M u-boot configure
UBOOT_CONFIG ??= "hihope-rzg2m"
UBOOT_CONFIG[hihope-rzg2m] = "r8a774a1_hihope-rzg2m_defconfig"

# flash writer
EXTRA_IMAGEDEPENDS += " flash-writer"

# libdrm
PREFERRED_VERSION_libdrm = "2.4.85"

# Add variable to Build Configuration in build log
BUILDCFG_VARS_append = " SOC_FAMILY"

# Command using to build kernel-module-gles
HOSTTOOLS += "sync"
```

## conf/machine/hihope-rzg2n.conf
```bitbake
#@TYPE: Machine
#@NAME: hihope-rzg2n machine
#@DESCRIPTION: Hoperun Technology HiHope RZ/G2N platform (hihope-rzg2n)

SOC_FAMILY = "r8a774b1"

DEFAULTTUNE ?= "cortexa57"
TUNE_CONF ?= "conf/machine/include/tune-cortexa57.inc"
require conf/machine/include/${SOC_FAMILY}.inc
require ${TUNE_CONF}

# 32BIT package install (default is disable)
# This variables can be used only in multilib.
USE_32BIT_PKGS ?= "0"
USE_32BIT_WAYLAND ?= "0"
USE_32BIT_MMP ?= "0"

MACHINE_FEATURES = ""

KERNEL_IMAGETYPE = "Image"
IMAGE_FSTYPES_append = " tar.bz2 ext4"

SERIAL_CONSOLE = "115200 ttySC0"

# Configuration for kernel
PREFERRED_PROVIDER_virtual/kernel = "linux-renesas"
# Device tree for RZG2N
KERNEL_DEVICETREE = " \
    renesas/r8a774b1-hihope-rzg2n.dtb \
    renesas/r8a774b1-hihope-rzg2n-ex.dtb \
    renesas/r8a774b1-hihope-rzg2n-ex-sata.dtb \
"

# Configuration for ARM Trusted Firmware
EXTRA_IMAGEDEPENDS += " arm-trusted-firmware optee-os"

# u-boot
PREFERRED_VERSION_u-boot = "v2018.09%"
EXTRA_IMAGEDEPENDS += " u-boot"
# G2M u-boot configure
UBOOT_CONFIG ??= "hihope-rzg2n"
UBOOT_CONFIG[hihope-rzg2n] = "r8a774b1_hihope-rzg2n_defconfig"

# flash writer
EXTRA_IMAGEDEPENDS += " flash-writer"

# libdrm
PREFERRED_VERSION_libdrm = "2.4.85"

# Add variable to Build Configuration in build log
BUILDCFG_VARS_append = " SOC_FAMILY"

# Command using to build kernel-module-gles
HOSTTOOLS += "sync"
```

## conf/machine/include/r8a774c0.inc
```bitbake
SOC_FAMILY =. "rzg2:"
require conf/machine/include/soc-family.inc
LINUXLIBCVERSION = "4.19%"
```

## conf/machine/include/rz-riscv64.inc
```bitbake
#@TYPE: Machine
#@NAME: rz-rv64 
#@SOC: RZ RISC-V 64-bit Group
#@DESCRIPTION: Machine configuration for all RZ RISC-V 64-bit LSI
#@MAINTAINER: Nhan Nguyen <nhan.nguyen.yb@renesas.com>

require conf/machine/include/riscv/tune-rz-rv64.inc

KERNEL_CLASSES = "kernel-fitimage"
KERNEL_IMAGETYPE = "Image"

PREFERRED_PROVIDER_virtual/kernel ?= "linux-renesas"
PREFERRED_PROVIDER_virtual/bootloader ?= "u-boot"

PREFERRED_VERSION_openocd-native = "riscv"
PREFERRED_VERSION_openocd = "riscv"

# Platform setting to build OpenSBI. TODO: edit
RISCV_SBI_PLAT = "renesas/rzf-dev"

## This sets u-boot as the default OpenSBI payload
RISCV_SBI_PAYLOAD ?= "u-boot.bin"

SERIAL_CONSOLES = "115200;ttySC0"

MACHINE_EXTRA_RRECOMMENDS += " kernel-modules"

IMAGE_FSTYPES += " ext4 tar.bz2"
KERNEL_DEVICETREE ?= " \
	renesas/r9a07g043f-dev.dtb \
"

## Do not update fstab file when using wic images
WIC_CREATE_EXTRA_ARGS ?= "--no-fstab-update"

UBOOT_MACHINE = "rzf-dev_ddr4_defconfig"

# U-Boot SPL
SPL_BINARY ?= "spl/u-boot-spl.bin"

# U-Boot ITB
UBOOT_SUFFIX ?= "itb"

# boot partition
IMAGE_BOOT_FILES ?= " \
    u-boot.itb \
    u-boot-spl.bin \
    fip.srec \
"

MACHINE_FEATURES = "screen keyboard ext2 ext3 ext4serial"

EXTRA_IMAGEDEPENDS += " opensbi u-boot"
```

## conf/machine/rzfive-dev.conf
```bitbake
require conf/machine/include/rz-riscv64.inc
#TODO: require cip-core.inc
#
#TODO: define variable
#SOC_FAMILY = "r9axxx"
require conf/machine/include/cip-core.inc
require conf/machine/include/rzfive-common.inc

# flash writer
EXTRA_IMAGEDEPENDS += " flash-writer"
```

## conf/machine/rzg2ul-ddr3l-dev.conf
```bitbake
#@TYPE: Machine
#@NAME: rzg2ul-ddr3l-dev machine
#@DESCRIPTION: RZ/G2UL DDR3L DEV platform

SOC_FAMILY = "r9a07g043u11"
require conf/machine/include/rzg2l-common.inc
require conf/machine/include/cip-core.inc

DEFAULTTUNE ?= "cortexa55"

TUNE_CONF ?= "conf/machine/include/tune-cortexa55.inc"
require ${TUNE_CONF}

PREFERRED_PROVIDER_virtual/kernel="linux-renesas"

UBOOT_CONFIG ??= "rzg2ul-ddr3l-dev"
UBOOT_CONFIG[rzg2ul-ddr3l-dev] = "rzg2ul-type1-ddr3l_defconfig"

# flash writer
EXTRA_IMAGEDEPENDS += " flash-writer"
```

## conf/machine/smarc-rzfive.conf
```bitbake
require conf/machine/include/rz-riscv64.inc
#TODO: require cip-core.inc

#TODO: define variable
#SOC_FAMILY = "r9axxx"

# flash writer
EXTRA_IMAGEDEPENDS += " flash-writer"
```
